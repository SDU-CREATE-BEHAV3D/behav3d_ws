// DM556Y speed and direction control with potentiometer.
// STEP pulses are generated by Timer1 so loop timing does not shape the pulse train.

const int STEP_PIN = 3;
const int DIR_PIN  = 4;
const int POT_PIN  = A0;

const int STEPS_PER_REV = 1600;
const float MAX_RPM = 700.0;

// Stop zone centered around 512.
const int POT_CENTER = 512;
const int STOP_HALF_WIDTH = 150;
const int STOP_MIN = POT_CENTER - STOP_HALF_WIDTH; // 362
const int STOP_MAX = POT_CENTER + STOP_HALF_WIDTH; // 662

// DM556Y minimum STEP high time. The timer code rounds this up to whole timer ticks.
const unsigned int STEP_HIGH_US = 5;

// Direction must be stable before the next STEP edge.
const unsigned int DIR_SETTLE_US = 5;

// Potentiometer update interval.
const unsigned long POT_UPDATE_INTERVAL_US = 100000; // 10 Hz

// Light exponential smoothing.
const float ALPHA = 0.25;

// Avoid reprogramming Timer1 for tiny ADC noise.
const float STEP_RATE_UPDATE_EPS_HZ = 1.0;

float filteredPot = 512.0;
float targetRPM = 0.0;
float currentStepHz = 0.0;
bool targetDir = LOW;
bool currentDir = LOW;
bool motorEnabled = false;
bool timerRunning = false;

unsigned long lastPotReadTime = 0;

volatile uint8_t* stepPort = 0;
uint8_t stepBitMask = 0;

// Future step accounting. This sketch still runs indefinitely while enabled.
volatile uint32_t stepsEmitted = 0;

// Timer updates are requested from loop() and applied by the Timer1 ISR after
// the STEP pulse has gone LOW. That avoids resetting TCNT1 during normal speed changes.
volatile bool pendingTimerUpdate = false;
volatile uint16_t pendingTop = 0;
volatile uint16_t pendingPulseTicks = 0;
volatile uint8_t pendingClockSelectBits = 0;

struct Timer1Settings {
  uint16_t top;
  uint16_t pulseTicks;
  uint8_t clockSelectBits;
};

float mapFloat(float x, float in_min, float in_max, float out_min, float out_max) {
  if (x < in_min) x = in_min;
  if (x > in_max) x = in_max;
  return (x - in_min) * (out_max - out_min) / (in_max - in_min) + out_min;
}

bool computeTimer1Settings(float stepHz, Timer1Settings* settings) {
  const uint16_t prescalers[] = { 1, 8, 64, 256, 1024 };
  const uint8_t clockBits[] = {
    _BV(CS10),
    _BV(CS11),
    _BV(CS11) | _BV(CS10),
    _BV(CS12),
    _BV(CS12) | _BV(CS10)
  };

  for (int i = 0; i < 5; i++) {
    const float timerHz = (float)F_CPU / (float)prescalers[i];
    const unsigned long topPlusOne = (unsigned long)((timerHz / stepHz) + 0.5);

    if (topPlusOne < 2 || topPlusOne > 65536UL) {
      continue;
    }

    const unsigned long pulseTicks =
      (unsigned long)(((float)STEP_HIGH_US * timerHz / 1000000.0) + 0.999);

    const unsigned long top = topPlusOne - 1;
    if (pulseTicks < 1 || pulseTicks >= top) {
      continue;
    }

    settings->top = (uint16_t)top;
    settings->pulseTicks = (uint16_t)pulseTicks;
    settings->clockSelectBits = clockBits[i];
    return true;
  }

  return false;
}

void setupTimer1() {
  noInterrupts();

  // Timer1 CTC mode: OCR1A is TOP. Compare A starts the STEP pulse,
  // Compare B ends it a few microseconds after the counter wraps to zero.
  TCCR1A = 0;
  TCCR1B = _BV(WGM12);
  TIMSK1 = 0;
  TCNT1 = 0;
  OCR1A = 0;
  OCR1B = 0;

  interrupts();
}

void stopStepTimer() {
  noInterrupts();
  TIMSK1 &= ~(_BV(OCIE1A) | _BV(OCIE1B));
  TCCR1B = _BV(WGM12); // Keep CTC mode selected, but stop the clock.
  TCNT1 = 0;
  pendingTimerUpdate = false;
  timerRunning = false;
  currentStepHz = 0.0;
  if (stepPort) {
    *stepPort &= ~stepBitMask;
  }
  interrupts();
}

bool startStepTimer(float stepHz) {
  Timer1Settings settings;
  if (!computeTimer1Settings(stepHz, &settings)) {
    stopStepTimer();
    return false;
  }

  noInterrupts();
  TCCR1B = _BV(WGM12); // Stop Timer1 while changing TOP/pulse width.
  TCNT1 = 0;
  OCR1A = settings.top;
  OCR1B = settings.pulseTicks;
  TIFR1 = _BV(OCF1A) | _BV(OCF1B); // Clear pending compare flags.
  pendingTimerUpdate = false;
  TIMSK1 |= _BV(OCIE1A) | _BV(OCIE1B);
  TCCR1B = _BV(WGM12) | settings.clockSelectBits;
  timerRunning = true;
  currentStepHz = stepHz;
  interrupts();

  return true;
}

bool requestStepTimer(float stepHz) {
  Timer1Settings settings;
  if (!computeTimer1Settings(stepHz, &settings)) {
    stopStepTimer();
    return false;
  }

  if (!timerRunning) {
    return startStepTimer(stepHz);
  }

  noInterrupts();
  pendingTop = settings.top;
  pendingPulseTicks = settings.pulseTicks;
  pendingClockSelectBits = settings.clockSelectBits;
  pendingTimerUpdate = true;
  currentStepHz = stepHz;
  interrupts();

  return true;
}

void applyDirection(bool dir) {
  if (dir == currentDir) {
    return;
  }

  // Do not allow a STEP edge too close to a direction change.
  if (timerRunning) {
    stopStepTimer();
  }

  digitalWrite(DIR_PIN, dir);
  delayMicroseconds(DIR_SETTLE_US);
  currentDir = dir;
}

void updateMotionCommand() {
  int rawPot = analogRead(POT_PIN);
  filteredPot = ALPHA * rawPot + (1.0 - ALPHA) * filteredPot;

  float rpm = 0.0;
  bool dir = LOW;
  bool enable = false;

  if (filteredPot < STOP_MIN) {
    dir = LOW;
    rpm = mapFloat(filteredPot, 0, STOP_MIN, MAX_RPM, 0.0);
    enable = (rpm > 0.5);
  }
  else if (filteredPot > STOP_MAX) {
    dir = HIGH;
    rpm = mapFloat(filteredPot, STOP_MAX, 1023, 0.0, MAX_RPM);
    enable = (rpm > 0.5);
  }
  else {
    rpm = 0.0;
    enable = false;
  }

  targetRPM = rpm;
  targetDir = dir;
  motorEnabled = enable;

  applyDirection(targetDir);

  if (!motorEnabled) {
    stopStepTimer();
    return;
  }

  const float stepHz = (targetRPM * STEPS_PER_REV) / 60.0;
  const float stepHzDelta = (stepHz > currentStepHz) ?
                            (stepHz - currentStepHz) :
                            (currentStepHz - stepHz);
  if (!timerRunning || stepHzDelta >= STEP_RATE_UPDATE_EPS_HZ) {
    requestStepTimer(stepHz);
  }
}

void setup() {
  pinMode(STEP_PIN, OUTPUT);
  pinMode(DIR_PIN, OUTPUT);

  digitalWrite(STEP_PIN, LOW);
  digitalWrite(DIR_PIN, LOW);

  stepPort = portOutputRegister(digitalPinToPort(STEP_PIN));
  stepBitMask = digitalPinToBitMask(STEP_PIN);

  setupTimer1();

  filteredPot = analogRead(POT_PIN);
  currentDir = LOW;
  updateMotionCommand();
}

void loop() {
  unsigned long now = micros();

  if (now - lastPotReadTime >= POT_UPDATE_INTERVAL_US) {
    lastPotReadTime = now;
    updateMotionCommand();
  }
}

ISR(TIMER1_COMPA_vect) {
  *stepPort |= stepBitMask;
  stepsEmitted++;
}

ISR(TIMER1_COMPB_vect) {
  *stepPort &= ~stepBitMask;

  if (pendingTimerUpdate) {
    OCR1A = pendingTop;
    OCR1B = pendingPulseTicks;
    TCCR1B = _BV(WGM12) | pendingClockSelectBits;
    pendingTimerUpdate = false;
  }
}
