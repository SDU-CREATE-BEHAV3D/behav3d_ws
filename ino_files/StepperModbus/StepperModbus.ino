/*
--- PHYSICAL WIRING SUMMARY ---
D07 (PORTH6) -> STEP  (driver PUL+), generated by Timer3 ISRs
D04 (PH3)    -> DIR   (driver DIR+, via Modbus coil 4)
D05 (PORTH4) -> ENA   (driver ENBL+, active LOW)
R8           -> Power relay (driver supply)
D00..D03     -> General outputs (via Modbus coils 0..3)

--- CODE ORGANIZATION  ---
1) StepperModbus.ino  [Main application]
   - Application entry point and high-level helpers.
   - stepperDriverOn()/stepperDriverOff(): pulse Relay 8 (R8) for driver power/latch.
   - Idle timeout: if no extrusion for 60s, set ENA HIGH (disable driver).
   - Includes and ties together Modbus setup/loop and timer control.

2) ModbusSetup.ino    [Modbus TCP server setup]
   - Initializes Modbus TCP server (IP/port, coils, holding registers).
   - Exposes coils 0..4 to map directly to D00..D04.
   - Configures holding registers (HR1 = step_rate_hz, HR2 = cfsMultiplier%).
   - Any network/init errors should be handled/logged here.

3) ModbusFunc.ino     [Modbus <-> I/O sync + extrusion state]
   - syncModbus(): copies Modbus coils 0..4 -> D00..D04 (DIR is on D04 via coil 4).
   - Reads HR1 (extruderFreq in Hz) and HR2 (cfsMultiplier in %) and updates timers.
   - 'extruding' logic:
       * extruding = coil[EXTRUDE_MAN] OR (coil[EXTRUDE_PRG] AND coil[PRG_STATE]).
       * When true:
           - Pull ENA LOW (D05/PORTH4) to enable the driver.
           - Enable Timer3 (active STEP on D07).
           - (Timer4 legacy may be enabled but is not wired today.)
       * When false:
           - Set ENA HIGH (driver disabled).
           - Disable timers.

4) InterruptSetup.ino [Hardware timers and ISRs]
   - setupTimer3()/setTimer3Freq()/enableTimer3(): generate STEP on D07 (PORTH6).
     * ISR(TIMER3_COMPA_vect): STEP HIGH (rising edge)
     * ISR(TIMER3_COMPB_vect): STEP LOW  (falling edge, TCNT3 reset)
   - setupTimer4()/setTimer4Freq()/enableTimer4(): legacy/aux pulse on D06 (PORTH5).
     * Currently not wired to the driver (safe to leave, does nothing physically).
   - Timer frequency equation (ATmega2560 @16 MHz, prescaler 1024):
       freq ≈ 16e6 / (1024 * (OVF + 1))
     'setTimerXFreq()' programs OCRxA/OCRxB accordingly.

--- MODBUS MAP (CURRENTLY USED) ---
Coils:
  0..4  -> D00..D04 (digital outputs, DIR is D04 via coil 4)
  10    -> EXTRUDE_MAN (manual extrusion enable)
  11    -> PRG_STATE   (program running state)
  12    -> EXTRUDE_PRG (program-controlled extrusion)
  13 (QUEUE_PUSH): rising edge -> enqueue 32-bit steps from HR3|HR4
  14 (CANCEL_ALL): cancels current job and clears the FIFO
Holding Registers:
  HR1   -> step_rate_hz (unsigned long, STEP frequency for Timer3 on D07)
  HR2   -> cfsMultiplier (%) scaling for legacy Timer4 on D06 (not wired today)
  HR3 = steps_lo, HR4 = steps_hi (compose 32-bit step count)
// OFF behavior (extruding=false) via coils 10/11/12 will also cancel and clear.

*/


#include <Controllino.h>
#include <SPI.h>
#include <Ethernet.h>
#include <ArduinoModbus.h>

#define NUMBER_INPUTS_COILS 16
#define NUMBER_IN_HOLD_REGISTERS 16


byte mac[] = { 0xDE, 0xAD, 0xBE, 0xEF, 0xFE, 0xED };
IPAddress ip(192, 168, 1, 10);
EthernetServer ethernetServer(502);
ModbusTCPServer modbusTCPServer;

unsigned long lastExtrude = 0;

void setup() {
  pinMode(CONTROLLINO_D6, OUTPUT);  // PH5
  pinMode(CONTROLLINO_D7, OUTPUT);  // PH6
  
  Serial.begin(9600);

  setupTimer3();
  setTimer3Freq(15624);
  setupTimer4();
  setTimer4Freq(15624);
  
  setupModbus();


}

void loop() {
  // listen for incoming clients
  EthernetClient client = ethernetServer.available();
  
  if (client) {
    Serial.println("new client");
    stepperDriverOn();
    modbusTCPServer.accept(client);

    while (client.connected()) {
      if (millis() - lastExtrude > 60000) PORTH |= (1 << 4); 
      if (modbusTCPServer.poll())
        syncModbus(&lastExtrude);
    }

    Serial.println("client disconnected");
    enableTimer3(false);
    enableTimer4(false);
    delay(500);
    stepperDriverOff();
  }
}
