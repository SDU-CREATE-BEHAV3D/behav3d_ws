// --- Physical mapping (Controllino Maxi Automation) ---
// D07 (PORTH6) -> STEP output to driver PUL+ (generated by Timer3 ISRs)
// D06 (PORTH5) -> Legacy/unused STEP output (generated by Timer4 ISRs) - not wired today
// D05 (PORTH4) -> ENA (Enable), active LOW -> driver ENBL+
// D04          -> DIR+ (Direction), driven via Modbus coil 4

// --- Timer3: StepPulseTimer (active path today) ---
// Generates STEP pulses at step_rate_hz (extruderFreq) on D07 (PORTH6).
// Rising edge: ISR(TIMER3_COMPA_vect) sets PH6 HIGH
// Falling edge: ISR(TIMER3_COMPB_vect) sets PH6 LOW (TCNT3 reset)

// --- Timer4: Legacy/Aux step generator ---
// Generates an alternative STEP pulse on D06 (PORTH5) scaled by cfsMultiplier.
// Currently not wired to the driver (safe to leave running, it does nothing physically).

// --- Step accumulator (modified in ISR) ---
volatile uint32_t steps_accum = 0;  // total steps to execute (>=0)
#define pulseLength 5

void setupTimer3() {
  noInterrupts();
  // Clear registers
  TCCR3A = 0;
  TCCR3B = 0;

  // Preload Timer
  TCNT3 = 0;

  // Prescaler 1024
  TCCR3B |= (1 << CS32) | (1 << CS30);

  // CTC
  // TCCR1B |= (1 << WGM12);

  interrupts();
}

void setTimer3Freq(long freq) {
  // Calculate Overflow: 1 Hz (16000000/((15624+1)*1024))
  unsigned long ovf = 16000000 / (1024 * freq) - 1;
  Serial.print("New OVF3 > ");
  Serial.println(ovf);

  noInterrupts();

  OCR3A = ovf - pulseLength;
  OCR3B = ovf;

  // Preload Timer
  TCNT3 = 0;

  interrupts();
}

void enableTimer3(bool enable) {
  if (enable) TIMSK3 |= (1 << OCIE3A) | (1 << OCIE3B) | (1 << TOIE3);
  else TIMSK3 &= ~( (1 << OCIE3A) | (1 << OCIE3B) | (1 << TOIE3) );
}

ISR(TIMER3_COMPA_vect) {
  PORTH |= (1 << 6);
}

ISR(TIMER3_COMPB_vect) {
  // Reset counter and bring STEP LOW
  TCNT3 = 0;
  PORTH &= ~(1 << 6);

  // Decrement accumulator by 1 on each falling edge
  if (steps_accum > 0) {
    steps_accum--;
    if (steps_accum == 0) {
      // No more steps: stop the pulse train
      enableTimer3(false);
    }
  }
}


ISR(TIMER3_OVF_vect) {
}

void setupTimer4() {
  noInterrupts();
  // Clear registers
  TCCR4A = 0;
  TCCR4B = 0;

  // Preload Timer
  TCNT4 = 0;

  // Prescaler 1024
  TCCR4B |= (1 << CS42) | (1 << CS40);

  // CTC
  // TCCR1B |= (1 << WGM12);

  interrupts();
}

void setTimer4Freq(long freq) {
  // Calculate Overflow: 1 Hz (16000000/((15624+1)*1024))
  unsigned long ovf = 16000000 / (1024 * freq) - 1;
  Serial.print("New OVF4 > ");
  Serial.println(ovf);
  
  noInterrupts();
  
  OCR4A = ovf - pulseLength;
  OCR4B = ovf;
  
  // Preload Timer
  TCNT4 = 0;

  interrupts();
}

void enableTimer4(bool enable) {
  if (enable) TIMSK4 |= (1 << OCIE4A) | (1 << OCIE4B) | (1 << TOIE4);
  else TIMSK4 &= ~( (1 << OCIE4A) | (1 << OCIE4B) | (1 << TOIE4) );
}

ISR(TIMER4_COMPA_vect) {
  PORTH |= (1 << 5);
}

ISR(TIMER4_COMPB_vect) {
  // Reset Timer2
  TCNT4 = 0;
  PORTH &= ~(1 << 5);
}

ISR(TIMER4_OVF_vect) {
}