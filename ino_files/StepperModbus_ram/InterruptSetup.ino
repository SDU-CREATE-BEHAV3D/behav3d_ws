// --- Physical mapping (Controllino Maxi Automation) ---
// D07 (PORTH6) -> STEP output to driver PUL+ (generated by Timer3 ISRs)
// D06 (PORTH5) -> Legacy/unused STEP output (generated by Timer4 ISRs) - not wired today
// D05 (PORTH4) -> ENA (Enable), active LOW -> driver ENBL+
// D04          -> DIR+ (Direction), driven via Modbus coil 4

// --- Timer3: active step generator ---
// Generates STEP pulses at step_rate_hz (extruderFreq) on D07 (PORTH6).
// Rising edge: ISR(TIMER3_COMPA_vect) sets PH6 HIGH
// Falling edge: ISR(TIMER3_COMPB_vect) sets PH6 LOW and advances the motion state

volatile uint32_t steps_accum = 0;                  // queued steps remaining
volatile uint32_t soft_position_steps = 0;          // 0 .. SOFTLIMIT_MAX_STEPS once homed
volatile bool soft_zero_known = false;              // true after limit trip + backoff
volatile uint32_t auto_backoff_steps_remaining = 0; // 4 mm homing backoff
volatile bool auto_backoff_active = false;
volatile bool auto_backoff_done = false;
volatile bool continuous_mode_active = false;       // legacy free-run mode
volatile int8_t motion_direction = 0;               // +1 away from limit, -1 toward limit
volatile bool timer3_enabled = false;

const uint32_t ISR_SOFTLIMIT_MAX_STEPS = 305UL * 6400UL;

#define pulseLength 5

static bool buildTimerConfig(uint32_t freq, uint16_t* compareA, uint16_t* compareB, uint16_t* prescaler, uint8_t* csBits) {
  if (freq < 1UL) {
    freq = 1UL;
  }

  const struct {
    uint16_t prescaler;
    uint8_t csBits;
  } options[] = {
    {8,    (1 << CS31)},
    {64,   (1 << CS31) | (1 << CS30)},
    {256,  (1 << CS32)},
    {1024, (1 << CS32) | (1 << CS30)},
  };

  for (uint8_t i = 0; i < (sizeof(options) / sizeof(options[0])); i++) {
    uint32_t ticks = 16000000UL / (options[i].prescaler * freq);
    if (ticks < (pulseLength + 1UL)) {
      continue;
    }

    uint32_t ovf = ticks - 1UL;
    if (ovf > 65535UL) {
      continue;
    }

    *compareA = (uint16_t)(ovf - pulseLength);
    *compareB = (uint16_t)ovf;
    *prescaler = options[i].prescaler;
    *csBits = options[i].csBits;
    return true;
  }

  // Extremely low requested rates fall back to the slowest timer setting.
  *compareA = (uint16_t)(65535UL - pulseLength);
  *compareB = 65535U;
  *prescaler = 1024U;
  *csBits = (1 << CS32) | (1 << CS30);
  return false;
}

static inline void updateSoftPositionOneStep() {
  if (!soft_zero_known) {
    return;
  }

  if (motion_direction > 0) {
    if (soft_position_steps < ISR_SOFTLIMIT_MAX_STEPS) {
      soft_position_steps++;
    }
  } else if (motion_direction < 0) {
    if (soft_position_steps > 0) {
      soft_position_steps--;
    }
  }
}

static inline bool reachedSoftBoundary() {
  if (!soft_zero_known) {
    return false;
  }

  if (motion_direction > 0) {
    return soft_position_steps >= ISR_SOFTLIMIT_MAX_STEPS;
  }

  if (motion_direction < 0) {
    return soft_position_steps == 0;
  }

  return false;
}

void setupTimer3() {
  noInterrupts();

  TCCR3A = 0;
  TCCR3B = 0;
  TCNT3 = 0;

  interrupts();
}

void setTimer3Freq(long freq) {
  uint16_t compareA;
  uint16_t compareB;
  uint16_t prescaler;
  uint8_t csBits;
  bool exactRange = buildTimerConfig((uint32_t)freq, &compareA, &compareB, &prescaler, &csBits);

  Serial.print("Timer3 freq=");
  Serial.print(freq);
  Serial.print("Hz prescaler=");
  Serial.print(prescaler);
  Serial.print(" OCR3B=");
  Serial.print(compareB);
  if (!exactRange) {
    Serial.print(" (clamped low)");
  }
  Serial.println();

  noInterrupts();

  TCCR3B = 0;
  OCR3A = compareA;
  OCR3B = compareB;
  TCNT3 = 0;
  TCCR3B = csBits;

  interrupts();
}

void enableTimer3(bool enable) {
  timer3_enabled = enable;
  if (enable) TIMSK3 |= (1 << OCIE3A) | (1 << OCIE3B) | (1 << TOIE3);
  else TIMSK3 &= ~((1 << OCIE3A) | (1 << OCIE3B) | (1 << TOIE3));
}

ISR(TIMER3_COMPA_vect) {
  PORTH |= (1 << 6);
}

ISR(TIMER3_COMPB_vect) {
  bool emittedStep = false;

  TCNT3 = 0;
  PORTH &= ~(1 << 6);

  if (auto_backoff_active) {
    if (steps_accum > 0) {
      steps_accum--;
    }

    if (auto_backoff_steps_remaining > 0) {
      auto_backoff_steps_remaining--;
      emittedStep = true;
    }

    if (auto_backoff_steps_remaining == 0) {
      auto_backoff_active = false;
      auto_backoff_done = true;
      continuous_mode_active = false;
      motion_direction = 0;
      steps_accum = 0;
      enableTimer3(false);
      return;
    }
  } else if (steps_accum > 0) {
    steps_accum--;
    emittedStep = true;
  } else if (continuous_mode_active) {
    emittedStep = true;
  } else {
    enableTimer3(false);
    return;
  }

  if (emittedStep) {
    updateSoftPositionOneStep();
    if (reachedSoftBoundary()) {
      enableTimer3(false);
    }
  }
}

ISR(TIMER3_OVF_vect) {
}

void setupTimer4() {
  noInterrupts();

  TCCR4A = 0;
  TCCR4B = 0;
  TCNT4 = 0;

  interrupts();
}

void setTimer4Freq(long freq) {
  uint16_t compareA;
  uint16_t compareB;
  uint16_t prescaler;
  uint8_t csBits;
  bool exactRange = buildTimerConfig((uint32_t)freq, &compareA, &compareB, &prescaler, &csBits);

  Serial.print("Timer4 freq=");
  Serial.print(freq);
  Serial.print("Hz prescaler=");
  Serial.print(prescaler);
  Serial.print(" OCR4B=");
  Serial.print(compareB);
  if (!exactRange) {
    Serial.print(" (clamped low)");
  }
  Serial.println();

  noInterrupts();

  TCCR4B = 0;
  OCR4A = compareA;
  OCR4B = compareB;
  TCNT4 = 0;
  TCCR4B = csBits;

  interrupts();
}

void enableTimer4(bool enable) {
  if (enable) TIMSK4 |= (1 << OCIE4A) | (1 << OCIE4B) | (1 << TOIE4);
  else TIMSK4 &= ~((1 << OCIE4A) | (1 << OCIE4B) | (1 << TOIE4));
}

ISR(TIMER4_COMPA_vect) {
  PORTH |= (1 << 5);
}

ISR(TIMER4_COMPB_vect) {
  TCNT4 = 0;
  PORTH &= ~(1 << 5);
}

ISR(TIMER4_OVF_vect) {
}
